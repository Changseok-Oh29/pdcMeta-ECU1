## meta-vehiclecontrol/conf/layer.conf
```bitbake
# We have a conf and classes directory, add to BBPATH
BBPATH =. "${LAYERDIR}:"

# We have recipes-* directories, add to BBFILES
BBFILES += "${LAYERDIR}/recipes-*/*/*.bb \
            ${LAYERDIR}/recipes-*/*/*.bbappend"

BBFILE_COLLECTIONS += "meta-vehiclecontrol"
BBFILE_PATTERN_meta-vehiclecontrol = "^${LAYERDIR}/"
BBFILE_PRIORITY_meta-vehiclecontrol = "8"

# Layer dependencies
LAYERDEPENDS_meta-vehiclecontrol = "core raspberrypi openembedded-layer"

# Compatible with Yocto releases (Kirkstone LTS)
LAYERSERIES_COMPAT_meta-vehiclecontrol = "kirkstone"
```

## meta-vehiclecontrol/conf/machine/raspberrypi4-64-vehiclecontrol.conf
```bitbake
# Machine configuration for VehicleControl ECU on Raspberry Pi

require conf/machine/raspberrypi4-64.conf

# Enable SPI for MCP2515 CAN controller
ENABLE_SPI_BUS = "1"
ENABLE_I2C = "1"
ENABLE_UART = "1"

# Device Tree Overlays for CAN
RPI_EXTRA_CONFIG += "\\n\
# VehicleControl ECU Hardware Configuration\\n\
dtparam=spi=on\\n\
dtoverlay=mcp2515-can0,oscillator=16000000,interrupt=25\\n\
dtparam=i2c_arm=on\\n\
dtparam=i2c_arm_baudrate=400000\\n\
"

# Kernel modules
KERNEL_MODULE_AUTOLOAD:rpi += "i2c-dev i2c-bcm2835 spi-bcm2835 can can-dev can-raw mcp251x"
```
